## config/boards/shields/arts/Kconfig.defconfig
```kconfig
if SHIELD_ARTS_LEFT
	config ZMK_KEYBOARD_NAME
		default "artsL"
		
	config I2C
		bool
		default y

	config SSD1306
		bool
		default y

	config SSD1306_REVERSE_MODE
		bool
		default y

	config LVGL_HOR_RES_MAX
		int
		default 128

	config LVGL_VER_RES_MAX
		int
		default 32

	config LVGL_VDB_SIZE
		int
		default 64

	config LVGL_DPI
		int
		default 148

	config LVGL_BITS_PER_PIXEL
		int
		default 1

	choice LVGL_COLOR_DEPTH
		default LVGL_COLOR_DEPTH_1
	endchoice
endif

if SHIELD_ARTS_RIGHT
	config ZMK_KEYBOARD_NAME
		default "artsR"

	config I2C
		bool
		default y

	config SSD1306
		bool
		default y

	config SSD1306_REVERSE_MODE
		bool
		default y

	config LVGL_HOR_RES_MAX
		int
		default 128

	config LVGL_VER_RES_MAX
		int
		default 32

	config LVGL_VDB_SIZE
		int
		default 64

	config LVGL_DPI
		int
		default 148

	config LVGL_BITS_PER_PIXEL
		int
		default 1

	choice LVGL_COLOR_DEPTH
		default LVGL_COLOR_DEPTH_1
	endchoice
endif
```

## config/boards/shields/arts/Kconfig.shield
```kconfig
config SHIELD_ARTS_LEFT
	def_bool $(shields_list_contains,artsL)

config SHIELD_ARTS_RIGHT
	def_bool $(shields_list_contains,artsR)
```
